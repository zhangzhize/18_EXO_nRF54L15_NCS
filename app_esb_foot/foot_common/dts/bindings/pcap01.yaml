## app_esb_foot/foot_common/dts/bindings/pcap01.yaml
```yaml
# dts/bindings/pcap01.yaml

description: PCAP01 capacitance-to-digital converter

compatible: "pcap01"

include: spi-device.yaml

properties:
  intn-gpios:
    type: phandle-array
    required: false
    description: Interrupt pin asserted when PCAP01 has measurement data.
```

## app_esb_foot/left/Kconfig
```kconfig
#
# Copyright (c) 2025
#
# SPDX-License-Identifier: LicenseRef-Nordic-5-Clause
#

source "Kconfig.zephyr"

rsource "../../common/Kconfig"

# ESB role and node ID are set explicitly in prj.conf.
```

## common/Kconfig
```kconfig
#
# Copyright (c) 2025
#
# SPDX-License-Identifier: LicenseRef-Nordic-5-Clause
#

# Node ID carried by the inter-node protocol.
config EXO_NODE_ID
	int "Exoskeleton Node ID"
	default 1
	range 1 6
	help
	  Unique node ID for this firmware image. The protocol values are
	  defined in common/inc/exo_node.h.
```

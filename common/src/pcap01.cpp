#include "pcap01.hpp"

#include <zephyr/kernel.h>
#include <zephyr/logging/log.h>
#include <zephyr/sys/util.h>

LOG_MODULE_REGISTER(pcap01, LOG_LEVEL_INF);

#define PCAP01_SRAM_COMM_WRITE 0x90  // b'1001 0000
#define PCAP01_SRAM_COMM_READ 0x10  // b'0001 0000

static const uint8_t PCap01_standard_firmware[4096] = {
  0x0, 0x0, 0x0, 0x62, 0x63, 0x0, 0x65, 0xBE, 0x1, 0x20, 0x26, 0x42,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 0xFF, 0xFF};

static const uint32_t PCap01_standard_config_reg[11] = {
  0x4200FF, /* 关闭OTP模式、开启程序读保护 */
  0x201022, /* 选择内部晶振频率50kHz (推荐)*/

  /* CDC只需要关心下面 Register 2-4的值 */
  // 0xFF470B, /* CMEAS_PORT_EN; CMEAS_SCHEME; CMEAS_DUMMY_EN; COMPENS_EXT_DIS; COMPENS_INT_DIS; RDCHG_INT_SEL; STRAYCOMP */
  0x3F470B,  /* 只测前两个 */
  0x002004, /* SEQ_TIME; CMEAS_FAKE; C_AVRG */
  0x000414, /* CMEAS_STARTPIN; CMEAS_TRIG_SEL; CMEAS_CYTIME; TMEAS_CYTIME; TMEAS_STARTPIN; TMEAS_TRIG_SEL */
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  0xFF000F,
  0x180047 /* 1.8v核心电压，选择标准模式 */
};

PCAP01::PCAP01()
{
  k_sem_init(&data_ready_sem_, 0, 1);
}

uint8_t PCAP01::spiReadWriteByte(uint8_t txdata)
{
  uint8_t rxdata = 0;
  (void)spiReadWrite(&txdata, &rxdata, 1);
  return rxdata;
}

int PCAP01::spiReadWrite(const uint8_t *tx, uint8_t *rx, size_t len)
{
  const struct spi_buf tx_buf = {
    .buf = const_cast<uint8_t *>(tx),
    .len = len,
  };
  const struct spi_buf_set tx_set = {
    .buffers = &tx_buf,
    .count = 1,
  };
  const struct spi_buf rx_buf = {
    .buf = rx,
    .len = len,
  };
  const struct spi_buf_set rx_set = {
    .buffers = &rx_buf,
    .count = 1,
  };

  last_spi_error_ = spi_transceive_dt(spi_spec_, &tx_set, &rx_set);
  return last_spi_error_;
}

int PCAP01::spiWrite(const uint8_t *tx, size_t len)
{
  const struct spi_buf tx_buf = {
    .buf = const_cast<uint8_t *>(tx),
    .len = len,
  };
  const struct spi_buf_set tx_set = {
    .buffers = &tx_buf,
    .count = 1,
  };

  last_spi_error_ = spi_write_dt(spi_spec_, &tx_set);
  return last_spi_error_;
}

PCAP01_ERROR PCAP01::begin(const struct spi_dt_spec *spi_spec,
                           const struct gpio_dt_spec *intn_gpio_spec)
{
  if (!spi_spec || !spi_is_ready_dt(spi_spec))
    return PCAP01_ERROR::INIT_ERROR;

  spi_spec_ = spi_spec;
  intn_gpio_spec_ = intn_gpio_spec;

  if (intn_gpio_spec_)
  {
    if (!gpio_is_ready_dt(intn_gpio_spec_))
      return PCAP01_ERROR::INIT_ERROR;

    int err = gpio_pin_configure_dt(intn_gpio_spec_, GPIO_INPUT);
    if (err)
      return PCAP01_ERROR::INIT_ERROR;

    intn_ctx_.instance = this;
    gpio_init_callback(&intn_ctx_.cb, intnIsrHandler, BIT(intn_gpio_spec_->pin));
    err = gpio_add_callback(intn_gpio_spec_->port, &intn_ctx_.cb);
    if (err)
      return PCAP01_ERROR::INIT_ERROR;

    err = gpio_pin_interrupt_configure_dt(intn_gpio_spec_, GPIO_INT_EDGE_TO_ACTIVE);
    if (err)
      return PCAP01_ERROR::INIT_ERROR;
  }

  last_spi_error_ = 0;

  sendOpcode(KOpcodeReset);
  k_msleep(10);
  if (last_spi_error_)
    return PCAP01_ERROR::SPI_BUS_ERROR;

  PCAP01_ERROR err = commTest();
  if (err != PCAP01_ERROR::OK)
    return err;

  err = writeStdFirmware();
  if (err != PCAP01_ERROR::OK)
    return err;

  writeStdConfig();

  writeRegister(KRunbitRegAddr, KRunbitRegData);
  sendOpcode(KOpcodePartialReset);
  k_msleep(2);
  if (last_spi_error_)
    return PCAP01_ERROR::SPI_BUS_ERROR;

  initLowPassFilter(1.5f, 200.0f);

  return PCAP01_ERROR::OK;
}

bool PCAP01::dataReady() const
{
  if (!intn_gpio_spec_)
    return true;

  int level = gpio_pin_get_dt(intn_gpio_spec_);
  if (level < 0)
    return false;

  return level > 0;
}

void PCAP01::clearDataReady()
{
  k_sem_reset(&data_ready_sem_);
}

bool PCAP01::waitDataReady(k_timeout_t timeout)
{
  if (!intn_gpio_spec_)
    return true;

  if (dataReady())
    return true;

  return k_sem_take(&data_ready_sem_, timeout) == 0;
}

void PCAP01::intnIsrHandler(const struct device *dev,
                            struct gpio_callback *cb,
                            uint32_t pins)
{
  ARG_UNUSED(dev);
  ARG_UNUSED(pins);

  struct intn_context *ctx = CONTAINER_OF(cb, struct intn_context, cb);
  if (ctx && ctx->instance)
  {
    k_sem_give(&ctx->instance->data_ready_sem_);
  }
}

uint8_t PCAP01::capacitanceRegister(uint8_t channel)
{
  static constexpr uint8_t reg_by_channel[CHANNEL_COUNT] = {
    KC1DivC0RegAddr,
    KC2DivC0RegAddr,
  };

  return channel < CHANNEL_COUNT ? reg_by_channel[channel] : 0;
}

void PCAP01::sendOpcode(uint8_t opcode)
{
  (void)spiWrite(&opcode, 1);
}

uint8_t PCAP01::sramComm(uint8_t comm_type, uint16_t addr, uint8_t data)
{
  uint8_t read_result = 0;

  uint8_t tx_buf[3];
  tx_buf[0] = comm_type | (addr >> 8);
  tx_buf[1] = addr & 0xFF;
  tx_buf[2] = (comm_type == PCAP01_SRAM_COMM_WRITE) ? data : 0xFF;

  uint8_t rx_buf[3] = {0};

  (void)spiReadWrite(tx_buf, rx_buf, sizeof(tx_buf));

  if (comm_type == PCAP01_SRAM_COMM_READ)
  {
    read_result = rx_buf[2];
  }

  return read_result;
}

void PCAP01::writeRegister(uint8_t reg_addr, uint32_t data)
{
  uint8_t tx_buf[4];
  tx_buf[0] = KCmdWriteReg | reg_addr;
  tx_buf[1] = (data >> 16) & 0xFF;
  tx_buf[2] = (data >> 8) & 0xFF;
  tx_buf[3] = data & 0xFF;

  (void)spiWrite(tx_buf, sizeof(tx_buf));
}

uint32_t PCAP01::readRawRegister(uint8_t reg_addr)
{
  uint8_t tx_buf[4] = {(uint8_t)(KCmdReadReg | reg_addr), 0xFF, 0xFF, 0xFF};
  uint8_t rx_buf[4] = {0};

  (void)spiReadWrite(tx_buf, rx_buf, sizeof(tx_buf));

  return (rx_buf[1] << 16) | (rx_buf[2] << 8) | rx_buf[3];
}

float PCAP01::readRegister(uint8_t reg_addr, uint8_t fractional_bits)
{
  uint32_t raw_data = readRawRegister(reg_addr);
  return (float)raw_data / (float)(1U << fractional_bits);
}

bool PCAP01::measureCapacitancesPF(k_timeout_t timeout,
                                   float capacitance_pf[CHANNEL_COUNT],
                                   uint32_t raw_count[CHANNEL_COUNT],
                                   int64_t *wait_ms,
                                   uint32_t *status)
{
  if (!capacitance_pf)
    return false;

  clearDataReady();
  int64_t wait_start_ms = k_uptime_get();
  sendOpcode(KOpcodeStartCDCMeas);
  if (last_spi_error_ || !waitDataReady(timeout))
    return false;

  if (wait_ms)
  {
    *wait_ms = k_uptime_delta(&wait_start_ms);
  }

  uint32_t measurement_status = readRawRegister(KStatusRegAddr);
  if (last_spi_error_)
    return false;
  if (status)
  {
    *status = measurement_status;
  }

  bool results_valid = true;
  for (uint8_t channel = 0; channel < CHANNEL_COUNT; channel++)
  {
    uint32_t raw = readRawRegister(capacitanceRegister(channel));
    if (last_spi_error_)
      return false;

    if (raw_count)
    {
      raw_count[channel] = raw;
    }
    capacitance_pf[channel] =
      ((float)raw / (float)(1U << KFractionalBits)) * KRefCapPF;
    if (raw == 0xFFFFFFU)
    {
      results_valid = false;
    }
  }

  return results_valid;
}

void PCAP01::writeStdConfig(void)
{
  for (uint8_t i = 0; i < 11; i++)
  {
    writeRegister(i, PCap01_standard_config_reg[i]);
    k_msleep(1);
  }
}

PCAP01_ERROR PCAP01::commTest(void)
{
  uint8_t ret = 0x00;
  uint8_t retry_count = 0;

  while (ret != 0x55)
  {
    sramComm(PCAP01_SRAM_COMM_WRITE, 0x0D, 0x55);
    k_msleep(1);
    ret = sramComm(PCAP01_SRAM_COMM_READ, 0x0D, 0xFF);
    if (last_spi_error_)
    {
      LOG_ERR("comm test SPI error %d", last_spi_error_);
      return PCAP01_ERROR::SPI_BUS_ERROR;
    }
    if (ret == 0x55)
    {
      break;
    }

    retry_count++;
    if (retry_count > 10)
    {
      LOG_ERR("comm test failed, SRAM[0x0D]=0x%02x", ret);
      return PCAP01_ERROR::COMM_TEST_FAILED;
    }

    LOG_WRN("comm test retry %u, SRAM[0x0D]=0x%02x", retry_count, ret);
    k_msleep(50);
  }

  LOG_INF("comm test ok");
  return PCAP01_ERROR::OK;
}

PCAP01_ERROR PCAP01::writeStdFirmware(void)
{
  uint8_t ret = 0xBB;

  for (uint16_t addr = 0; addr < 4096; addr++)
  {
    uint8_t retry_count = 0;

    while (PCap01_standard_firmware[addr] != ret)
    {
      sramComm(PCAP01_SRAM_COMM_WRITE, addr, PCap01_standard_firmware[addr]);
      ret = sramComm(PCAP01_SRAM_COMM_READ, addr, 0xFF);
      if (last_spi_error_)
      {
        return PCAP01_ERROR::SPI_BUS_ERROR;
      }

      retry_count++;
      if (retry_count > 5)
      {
        return PCAP01_ERROR::FIRMWARE_LOAD_FAILED;
      }
    }
    ret = 0xBB;
  }

  for (uint16_t addr = 0; addr < 30; addr++)
  {
    sramComm(PCAP01_SRAM_COMM_READ, addr, 0xFF);
  }

  return PCAP01_ERROR::OK;
}

void PCAP01::initLowPassFilter(float cutoff_freq, float sampling_freq)
{
  if (cutoff_freq >= sampling_freq / 2.0f)
  {
    filter_alpha_ = 1.0f;
  }
  else
  {
    float dt = 1.0f / sampling_freq;
    float rc = 1.0f / (2.0f * 3.1415926535f * cutoff_freq);
    filter_alpha_ = dt / (rc + dt);
  }

  for (uint8_t i = 0; i < CHANNEL_COUNT; i++)
  {
    is_filter_first_run_[i] = true;
    filtered_data_[i] = 0.0f;
  }
}

float PCAP01::applyLowPassFilter(uint8_t node_index, float raw_capacitance)
{
  if (node_index >= CHANNEL_COUNT || !enable_filter_)
    return raw_capacitance;

  if (is_filter_first_run_[node_index])
  {
    filtered_data_[node_index] = raw_capacitance;
    is_filter_first_run_[node_index] = false;
  }
  else
  {
    filtered_data_[node_index] = filter_alpha_ * raw_capacitance + (1.0f - filter_alpha_) * filtered_data_[node_index];
  }

  return filtered_data_[node_index];
}
